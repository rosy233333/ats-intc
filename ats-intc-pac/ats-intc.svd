# ats-intc register map
File version: 0.0
Asynchronous task scheduler and Interrupt controller description
Registers are 64-bit, write-only, reset 0x0 unless marked. A register's access mark holds for its fields unless they carry their own. Offsets are from the block's base; lines under a group give offsets from that group; [hi:lo] are bit positions; {n}, {i} and the like mark numbered series; 'fields as' and 'values as' point back to an identical list; <NAME> marks a mode.

## Memory map
0x10000000 ATS-INTC size 0x1000000 — Asynchronous task scheduler, IPC controller and Interrupt controller description

## ATS-INTC — Asynchronous task scheduler, IPC controller and Interrupt controller description
Base 0x10000000
{0x0+0x1000*i} process{i} (i=0..4095) group — Related registers of one process
  0x00 ats group — Async task scheduler of one process
    0x00 dequeue ro — The priority queue dequeue register
    {0x8+8k} enqueue{k} (k=0..254) — The priority queue enqueue registers
  0x800 ipcc group — IPC controller of one process
    0x00 send — The IPC send register
    {0x8+8k} ipc-bq{k} (k=0..30) — Block queue enqueue registers
  0x900 intc group — Interrupt controller
    {0x0+8k} intr-enqueue{k} (k=0..223) — Interrupt handler queue enqueue register
